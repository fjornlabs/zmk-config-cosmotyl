#include "cosmotyl.dtsi"
#include "cosmotyl-layouts.dtsi"

/ {
    chosen {
        zmk,kscan = &kscan0;
        zmk,physical-layout = &default_layout;
    };
};

&default_layout {
    transform = <&global_transform>;
    kscan = <&kscan0>;
};
